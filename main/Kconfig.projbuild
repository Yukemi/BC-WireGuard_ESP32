## main/Kconfig.projbuild
```kconfig
menu "WireGuard Configuration"

    config ESP_WIFI_SSID
        string "WiFi SSID"
        default "myssid"
        help
            SSID (network name) for the example to connect to.

    config ESP_WIFI_PASSWORD
        string "WiFi Password"
        default "mypassword"
        help
            WiFi password (WPA or WPA2) for the example to use.

    config ESP_MAXIMUM_RETRY
        int "Maximum retry"
        default 5
        help
            Set the Maximum retry to avoid station reconnecting to the AP
            unlimited when the AP is really inexistent.

    config WG_PRIVATE_KEY
        string "Wireguard Private Key"
        default "IsvT72MAXzA8EtV0FSD1QT59B4x0oe6Uea5rd/dDzhE="
        help
            Private key of the WireGuard device.

    config WG_LOCAL_IP_ADDRESS
        string "Wireguard local IP address"
        default "192.168.4.58"
        help
            Local IP address of the WireGuard device.

    config WG_LOCAL_IP_NETMASK
        string "Wireguard local netmask"
        default "255.255.255.0"
        help
            Netmask of the local network the WireGuard device belongs to.

    config WG_LOCAL_PORT
        int "Wireguard local port"
        default 11010
        help
            Local port to listen.

    config WG_PEER_PUBLIC_KEY
        string "Wireguard remote peer public key"
        default "FjrsQ/HD1Q8fUlFILIasDlOuajMeZov4NGqMJpkswiw="
        help
            Public key of the remote peer.

    config WG_PRESHARED_KEY
        string "Wireguard pre-shared symmetric key"
        default "0/2H97Sd5EJ9LAAAYUglVjPYv7ihNIm/ziuv6BtSI50="
        help
            Public key of the remote peer.

    config WG_PEER_ADDRESS
        string "Wireguard remote peer address"
        default "demo.wireguard.com"
        help
            Address of the remote peer.

    config WG_PEER_PORT
        int "Wireguard remote peer port"
        default 12912
        help
            Port number of the remote peer.

    config WG_PERSISTENT_KEEP_ALIVE
        int "Interval to send an authenticated empty packet"
        default 0
        help
            A seconds interval, between 1 and 65535 inclusive, of how often to
            send an authenticated empty packet to the peer for the purpose of
            keeping a stateful firewall or NAT mapping valid persistently
    config EXAMPLE_PING_ADDRESS
        string "Target IP address or name"
        default "192.168.4.254"
        help
            Target IP address to send ICMP echo requests.
endmenu

menu "Iperf"

    config IPERF_DEF_SOCKET_RX_TIMEOUT
        int "iperf socket TCP/UDP rx timeout in seconds"
        default 10
        help
            The value is used for iperf socket TCP/UDP rx timeout, iperf will be aborted
            and socket will be closed and shutdown.

    config IPERF_DEF_SOCKET_TCP_TX_TIMEOUT
        int "iperf socket TCP tx timeout in seconds"
        default 10
        help
            The value is used for iperf socket TCP tx timeout, iperf will be aborted
            and socket will be closed and shutdown.

    config IPERF_DEF_TRAFFIC_TASK_PRIORITY
        int "default iperf traffic task priority"
        default 4
        help
           The value is used for iperf traffic task priority.

    config IPERF_DEF_REPORT_TASK_PRIORITY
        int "iperf result report task priority"
        default 6
        help
           The value is used for iperf result report task priority.

    config IPERF_DEF_TCP_TX_BUFFER_LEN
        int "default tcp tx buffer length"
        default 16384
        help
           The value of default tcp tx buffer length.

    config IPERF_DEF_TCP_RX_BUFFER_LEN
        int "default tcp rx buffer length"
        default 16384
        help
           The value of default tcp rx buffer length.

    config IPERF_DEF_IPV4_UDP_TX_BUFFER_LEN
        int "default ipv4 udp tx buffer length"
        default 1470
        help
           The value of default ipv4 udp tx buffer length.

    config IPERF_DEF_IPV6_UDP_TX_BUFFER_LEN
        int "default ipv6 udp tx buffer length"
        default 1450
        help
           The value of default ipv6 udp tx buffer length.

    config IPERF_DEF_UDP_RX_BUFFER_LEN
        int "default udp rx buffer length"
        default 1500
        help
           The value of default udp rx buffer length.
           Not recommended to set the value too small due to udp does not support fragmentation.

endmenu

menu "Console Command: Iperf"

    config IPERF_CMD_DEFAULT_BW_MBPS
        bool "Use 'm' as default unit for '--bandwidth'"
        default n
        help
            This option is for compatibility with iperf 0.1, as the default bandwidth unit in iperf 0.1 is Mbps.

endmenu
```

## sdkconfig.defaults
```kconfig
CONFIG_ESP_CONSOLE_UART_DEFAULT=y
CONFIG_ESP_CONSOLE_UART_NUM=0
CONFIG_ESP_CONSOLE_UART_BAUDRATE=115200
CONFIG_VFS_SUPPORT_TERMIOS=y
CONFIG_ESP_CONSOLE_SECONDARY_USB_SERIAL_JTAG=n
CONFIG_HEAP_TRACING_DEST=none
CONFIG_HEAP_TRACING_STACK_DEPTH=10
```
